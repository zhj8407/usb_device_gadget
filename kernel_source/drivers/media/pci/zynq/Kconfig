## kernel_source/drivers/media/pci/zynq/Kconfig
```kconfig
config VIDEO_ZYNQ
	tristate "Xilinx Zynq  support"
	select VIDEOBUF2_DMA_CONTIG
	select VIDEOBUF2_VMALLOC 
	depends on VIDEO_DEV && PCI && I2C && SND
	select SND_PCM
	select SERIAL_CORE
	help
	  This is a video4linux driver for Xilinx Zynq  based Video/Audio PCI control module.

	  To compile this driver as a module, choose M here: the
	  module will be called zynq

config VIDEO_ZYNQ_HDMI  
	tristate "ADV762X HDMI Transceiver support"
	depends on I2C 
	help
	  This is a driver for ADV762X's control module.

	  To compile this driver as a module, choose M here: the
	  module will be called hdmitrans
	  
config SERIAL_ZYNQ_CONSOLE
	bool "Support for console on ZYNQ serial port"
	depends on VIDEO_ZYNQ=y || VIDEO_ZYNQ=m
	select SERIAL_CORE_CONSOLE
	help
	  Say Y here if you wish to use a ZYNQ uart as the system
	  console (the system console is the device which receives all kernel
	  messages and warnings and which allows logins in single user mode).
```
